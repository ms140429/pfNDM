/* USER CODE BEGIN Header */
/**
  ******************************************************************************
  * @file           : main.c
  * @brief          : Main program body
  ******************************************************************************
  * @attention
  *
  * Copyright (c) 2023 STMicroelectronics.
  * All rights reserved.
  *
  * This software is licensed under terms that can be found in the LICENSE file
  * in the root directory of this software component.
  * If no LICENSE file comes with this software, it is provided AS-IS.
  *
  ******************************************************************************
  */
/* USER CODE END Header */
/* Includes ------------------------------------------------------------------*/
#include "main.h"
#include "crc.h"
#include "gpio.h"
#include "fmc.h"
#include "app_x-cube-ai.h"

/* Private includes ----------------------------------------------------------*/
/* USER CODE BEGIN Includes */
#include <stdio.h>
#include <string.h>
#include "lcd.h"
#include "sys.h"
#include "delay.h"
/* USER CODE END Includes */

/* Private typedef -----------------------------------------------------------*/
/* USER CODE BEGIN PTD */

/* USER CODE END PTD */

/* Private define ------------------------------------------------------------*/
/* USER CODE BEGIN PD */

/* USER CODE END PD */

/* Private macro -------------------------------------------------------------*/
/* USER CODE BEGIN PM */

/* USER CODE END PM */

/* Private variables ---------------------------------------------------------*/

/* USER CODE BEGIN PV */

/* USER CODE END PV */

/* Private function prototypes -----------------------------------------------*/
void SystemClock_Config(void);
/* USER CODE BEGIN PFP */

/* USER CODE END PFP */

/* Private user code ---------------------------------------------------------*/
/* USER CODE BEGIN 0 */
AI_ALIGNED(32)
static ai_handle network = AI_HANDLE_NULL;
AI_ALIGNED(32)
static ai_u8 activations_f01[AI_NETWORK_F01_DATA_ACTIVATIONS_SIZE];
static ai_u8 activations_f02[AI_NETWORK_F02_DATA_ACTIVATIONS_SIZE];
static ai_u8 activations_fu[AI_NETWORK_FU_DATA_ACTIVATIONS_SIZE];
static ai_u8 activations_fx[AI_NETWORK_FX_DATA_ACTIVATIONS_SIZE];
static ai_u8 activations_fy[AI_NETWORK_FY_DATA_ACTIVATIONS_SIZE];

static ai_float in_data_f01[AI_NETWORK_F01_IN_1_SIZE];
static ai_float in_data_f02[AI_NETWORK_F02_IN_1_SIZE];
static ai_float in_data_fu[AI_NETWORK_FU_IN_1_SIZE];
static ai_float in_data_fx[AI_NETWORK_FX_IN_1_SIZE];
static ai_float in_data_fy[AI_NETWORK_FY_IN_1_SIZE];

static ai_float out_data_f01[AI_NETWORK_F01_OUT_1_SIZE];
static ai_float out_data_f02[AI_NETWORK_F02_OUT_1_SIZE];
static ai_float out_data_fu[AI_NETWORK_FU_OUT_1_SIZE];
static ai_float out_data_fx[AI_NETWORK_FX_OUT_1_SIZE];
static ai_float out_data_fy[AI_NETWORK_FY_OUT_1_SIZE];

static ai_buffer *ai_input_f01;
static ai_buffer *ai_output_f01;
static ai_buffer *ai_input_f02;
static ai_buffer *ai_output_f02;
static ai_buffer *ai_input_fu;
static ai_buffer *ai_output_fu;
static ai_buffer *ai_input_fx;
static ai_buffer *ai_output_fx;
static ai_buffer *ai_input_fy;
static ai_buffer *ai_output_fy;


float input_f01[64]={8.477944135665893555e-01,5.344344377517700195e-01,7.870666384696960449e-01,1.044363141059875488e+00,
8.474816679954528809e-01,5.345278978347778320e-01,7.870666384696960449e-01,1.043593883514404297e+00,
8.450333476066589355e-01,5.347828865051269531e-01,7.870666384696960449e-01,1.042681217193603516e+00,
8.445119261741638184e-01,5.345383882522583008e-01,7.870666384696960449e-01,1.044728636741638184e+00,
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8.344804644584655762e-01,5.358564853668212891e-01,7.870666384696960449e-01,1.044443249702453613e+00};
float output_f01[56];
float input_f02[56];
float output_f02[48];
float input_fu_a[128][10]={1.993289440870285034e-01,1.923294663429260254e-01,-9.737824201583862305e-01,2.128760367631912231e-01,7.499917745590209961e-01,3.050623834133148193e-01,-6.885003447532653809e-01,2.748489975929260254e-01,7.413330674171447754e-01,9.967790246009826660e-01,
2.038079947233200073e-01,1.881244033575057983e-01,-9.737285971641540527e-01,2.130321264266967773e-01,7.499917149543762207e-01,3.050377070903778076e-01,-6.884378194808959961e-01,2.747851014137268066e-01,7.412512898445129395e-01,9.967598319053649902e-01,
2.063447237014770508e-01,1.914140433073043823e-01,-9.738019108772277832e-01,2.129340767860412598e-01,7.499917149543762207e-01,3.050490319728851318e-01,-6.884387135505676270e-01,2.747798562049865723e-01,7.412501573562622070e-01,9.968104958534240723e-01,
2.043259739875793457e-01,1.912055760622024536e-01,-9.731622338294982910e-01,2.131949812173843384e-01,7.499914169311523438e-01,3.048634529113769531e-01,-6.882404685020446777e-01,2.745858728885650635e-01,7.409941554069519043e-01,9.962413907051086426e-01,
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2.188149690628051758e-01,1.915410906076431274e-01,-9.735422134399414062e-01,2.088478654623031616e-01,7.499914169311523438e-01,3.046270310878753662e-01,-6.885473728179931641e-01,2.750131785869598389e-01,7.414376139640808105e-01,9.956917166709899902e-01,
};
float input_fu[10];
float output_fu[48];
float input_fx0[48];
float output_fx0[48];
float input_fx[48];
float output_fx[48];
float input_fy[48];
float output_fy[4];
float true_value[128][4]={8.444541096687316895e-01,5.355861186981201172e-01,7.870666384696960449e-01,1.044061541557312012e+00,
8.489671349525451660e-01,5.361953973770141602e-01,7.870666384696960449e-01,1.044388532638549805e+00,
8.525840044021606445e-01,5.353303551673889160e-01,7.870666384696960449e-01,1.044700860977172852e+00,
8.565113544464111328e-01,5.356600880622863770e-01,7.870666384696960449e-01,1.044627547264099121e+00,
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8.775171041488647461e-01,5.414984226226806641e-01,7.894005775451660156e-01,1.047905325889587402e+00,
};

float true_a[4];
char lcd_1[18];
char lcd_2[18];
char lcd_3[18];
char lcd_4[18];
char lcd_5[18];
char lcd_6[18];
char lcd_7[18];
char lcd_8[18];
char lcd_9[18];

int aiInit_f01(void) {
  ai_error err;
  const ai_handle acts[] = { activations_f01 };
  err = ai_network_f01_create_and_init(&network, acts, NULL);
  if (err.type != AI_ERROR_NONE) { while(1); };

  ai_input_f01 = ai_network_f01_inputs_get(network, NULL);
  ai_output_f01 = ai_network_f01_outputs_get(network, NULL);

  return 0;
}
int aiRun_f01(const void *in_data, void *out_data) {
  ai_i32 n_batch;
  ai_error err;
  
  ai_input_f01[0].data = AI_HANDLE_PTR(in_data);
  ai_output_f01[0].data = AI_HANDLE_PTR(out_data);
  n_batch = ai_network_f01_run(network, &ai_input_f01[0], &ai_output_f01[0]);
  if (n_batch != 1) {
      err = ai_network_f01_get_error(network);
  };
	 return 0;
}
int aiInit_fu(void) {
  ai_error err;
  const ai_handle acts[] = { activations_fu };
  err = ai_network_fu_create_and_init(&network, acts, NULL);
  if (err.type != AI_ERROR_NONE) { while(1); };

  ai_input_fu = ai_network_fu_inputs_get(network, NULL);
  ai_output_fu = ai_network_fu_outputs_get(network, NULL);

  return 0;
}
int aiRun_fu(const void *in_data, void *out_data) {
  ai_i32 n_batch;
  ai_error err;
  
  ai_input_fu[0].data = AI_HANDLE_PTR(in_data);
  ai_output_fu[0].data = AI_HANDLE_PTR(out_data);
  n_batch = ai_network_fu_run(network, &ai_input_fu[0], &ai_output_fu[0]);
  if (n_batch != 1) {
      err = ai_network_fu_get_error(network);
  };
	 return 0;
}
int aiInit_fx(void) {
  ai_error err;
  const ai_handle acts[] = { activations_fx };
  err = ai_network_fx_create_and_init(&network, acts, NULL);
  if (err.type != AI_ERROR_NONE) { while(1); };

  ai_input_fx = ai_network_fx_inputs_get(network, NULL);
  ai_output_fx = ai_network_fx_outputs_get(network, NULL);

  return 0;
}
int aiRun_fx(const void *in_data, void *out_data) {
  ai_i32 n_batch;
  ai_error err;
  
  ai_input_fx[0].data = AI_HANDLE_PTR(in_data);
  ai_output_fx[0].data = AI_HANDLE_PTR(out_data);
  n_batch = ai_network_fx_run(network, &ai_input_fx[0], &ai_output_fx[0]);
  if (n_batch != 1) {
      err = ai_network_fx_get_error(network);
  };
	 return 0;
}
int aiInit_fy(void) {
  ai_error err;
  const ai_handle acts[] = { activations_fy };
  err = ai_network_fy_create_and_init(&network, acts, NULL);
  if (err.type != AI_ERROR_NONE) { while(1); };

  ai_input_fy = ai_network_fy_inputs_get(network, NULL);
  ai_output_fy = ai_network_fy_outputs_get(network, NULL);

  return 0;
}
int aiRun_fy(const void *in_data, void *out_data) {
  ai_i32 n_batch;
  ai_error err;
  
  ai_input_fy[0].data = AI_HANDLE_PTR(in_data);
  ai_output_fy[0].data = AI_HANDLE_PTR(out_data);
  n_batch = ai_network_fy_run(network, &ai_input_fy[0], &ai_output_fy[0]);
  if (n_batch != 1) {
      err = ai_network_fy_get_error(network);
  };
	 return 0;
}
int aiInit_f02(void) {
  ai_error err;
  const ai_handle acts[] = { activations_f02 };
  err = ai_network_f02_create_and_init(&network, acts, NULL);
  if (err.type != AI_ERROR_NONE) { while(1); };

  ai_input_f02 = ai_network_f02_inputs_get(network, NULL);
  ai_output_f02 = ai_network_f02_outputs_get(network, NULL);

  return 0;
}
int aiRun_f02(const void *in_data, void *out_data) {
  ai_i32 n_batch;
  ai_error err;
  
  ai_input_f02[0].data = AI_HANDLE_PTR(in_data);
  ai_output_f02[0].data = AI_HANDLE_PTR(out_data);
  n_batch = ai_network_f02_run(network, &ai_input_f02[0], &ai_output_f02[0]);
  if (n_batch != 1) {
      err = ai_network_f02_get_error(network);
  };
	 return 0;
}
/* USER CODE END 0 */

/**
  * @brief  The application entry point.
  * @retval int
  */
int main(void)
{
  /* USER CODE BEGIN 1 */

  /* USER CODE END 1 */

  /* Enable I-Cache---------------------------------------------------------*/
  SCB_EnableICache();

  /* Enable D-Cache---------------------------------------------------------*/
  SCB_EnableDCache();

  /* MCU Configuration--------------------------------------------------------*/

  /* Reset of all peripherals, Initializes the Flash interface and the Systick. */
  HAL_Init();

  /* USER CODE BEGIN Init */

  /* USER CODE END Init */

  /* Configure the system clock */
  SystemClock_Config();

  /* USER CODE BEGIN SysInit */

  /* USER CODE END SysInit */

  /* Initialize all configured peripherals */
  MX_GPIO_Init();
  MX_CRC_Init();
  MX_FMC_Init();
  MX_X_CUBE_AI_Init();
  /* USER CODE BEGIN 2 */
	LCD_Init();
  POINT_COLOR=RED; 	
  aiInit_f01();
	aiRun_f01(input_f01,output_f01);
	int k=0;
	for (int j = 0; j < 4;j++) {
       for (int i = j; i < 56; i += 4) {
          if (k < 56) {
             input_f02[k++] = output_f01[i];
            }
        }
    }

	aiInit_f02();
	aiRun_f02(input_f02,output_f02);
	memcpy(input_fx0,output_f02,sizeof(input_fx0));
	aiInit_fx();
	aiRun_fx(input_fx0,output_fx0);

	//循环输入fu
	for(int i=0;i<128;i++)
		{
			for (int j=0; j <10; j++) {
       input_fu[j] = input_fu_a[i][j];}
	 aiInit_fu();	
	 aiRun_fu(input_fu,output_fu);

	 //将fx和fu相加
	 float *ptr_fx0= output_fx0;
   float *ptr_fu = output_fu;
   float *ptr_fx = input_fx;
   for (int m=0;m<48;m++) {
       *ptr_fx = *ptr_fx0+ *ptr_fu;
        ptr_fx0++;
        ptr_fu++;
        ptr_fx++;
    }
	memcpy(input_fy,input_fx,sizeof(input_fy));
	//计算fy输出
	aiInit_fy();
	aiRun_fy(input_fy,output_fy);
	printf("output is\r\n");
	for(int i=0;i<4;i++)
	{printf("%f\r\n",output_fy[i]);}
  for (int j=0; j <4; j++) 
  {true_a[j] = true_value[i][j];}
	float mse=0;
	for(int i=0;i<4;i++)
	{
		float diff=(true_a[i] - output_fy[i])*100;
	  mse+=diff*diff/4;}
	LCD_Clear(WHITE);
	LCD_ShowString(80,20,240,24,24,"RESULT");

	LCD_ShowString(30,50,220,16,16,"Permanent magnet");
	sprintf((char*)lcd_1,"pred:%.1f C",output_fy[0]*100);
	LCD_ShowString(60,70,220,16,16,lcd_1);
	sprintf((char*)lcd_5,"true:%.1f C",true_a[0]*100);
	LCD_ShowString(60,90,220,16,16,lcd_5);
	
	LCD_ShowString(30,110,220,16,16,"Stator yoke");
  sprintf((char*)lcd_2,"pred:%.1f C",output_fy[1]*100);
	LCD_ShowString(60,130,220,16,16,lcd_2);
	sprintf((char*)lcd_6,"true:%.1f C",true_a[1]*100);
	LCD_ShowString(60,150,220,16,16,lcd_6);
	
	LCD_ShowString(30,170,220,16,16,"Stator teeth");
	sprintf((char*)lcd_3,"pred:%.1f C",output_fy[2]*100);
	LCD_ShowString(60,190,220,16,16,lcd_3);
	sprintf((char*)lcd_7,"true:%.1f C",true_a[2]*100);
	LCD_ShowString(60,210,220,16,16,lcd_7);
	
	LCD_ShowString(30,230,220,16,16,"Stator winding");
	sprintf((char*)lcd_4,"pred:%.1f C",output_fy[3]*100);
	LCD_ShowString(60,250,220,16,16,lcd_4);
	sprintf((char*)lcd_8,"true:%.1f C",true_a[3]*100);
	LCD_ShowString(60,270,220,16,16,lcd_8);
	
	sprintf((char*)lcd_9,"MSE:%f",mse);
	LCD_ShowString(60,300,220,16,16,lcd_9);
//	HAL_Delay(1000);
	
	aiInit_fx();
	aiRun_fx(input_fx,output_fx); 
	memcpy(output_fx0,output_fx,sizeof(output_fx0));
 }
	//printf("output is\r\n");
	//for(int i=0;i<4;i++)
	//{printf("%f\r\n",output_fy[i]);}	
  /* USER CODE END 2 */

  /* Infinite loop */
  /* USER CODE BEGIN WHILE */
  while (1)
  {
    /* USER CODE END WHILE */

  //MX_X_CUBE_AI_Process();
    /* USER CODE BEGIN 3 */
  }
  /* USER CODE END 3 */
}

/**
  * @brief System Clock Configuration
  * @retval None
  */
void SystemClock_Config(void)
{
  RCC_OscInitTypeDef RCC_OscInitStruct = {0};
  RCC_ClkInitTypeDef RCC_ClkInitStruct = {0};

  /** Supply configuration update enable
  */
  HAL_PWREx_ConfigSupply(PWR_LDO_SUPPLY);

  /** Configure the main internal regulator output voltage
  */
  __HAL_PWR_VOLTAGESCALING_CONFIG(PWR_REGULATOR_VOLTAGE_SCALE1);

  while(!__HAL_PWR_GET_FLAG(PWR_FLAG_VOSRDY)) {}

  __HAL_RCC_SYSCFG_CLK_ENABLE();
  __HAL_PWR_VOLTAGESCALING_CONFIG(PWR_REGULATOR_VOLTAGE_SCALE0);

  while(!__HAL_PWR_GET_FLAG(PWR_FLAG_VOSRDY)) {}

  /** Initializes the RCC Oscillators according to the specified parameters
  * in the RCC_OscInitTypeDef structure.
  */
  RCC_OscInitStruct.OscillatorType = RCC_OSCILLATORTYPE_HSE;
  RCC_OscInitStruct.HSEState = RCC_HSE_ON;
  RCC_OscInitStruct.PLL.PLLState = RCC_PLL_ON;
  RCC_OscInitStruct.PLL.PLLSource = RCC_PLLSOURCE_HSE;
  RCC_OscInitStruct.PLL.PLLM = 5;
  RCC_OscInitStruct.PLL.PLLN = 160;
  RCC_OscInitStruct.PLL.PLLP = 2;
  RCC_OscInitStruct.PLL.PLLQ = 20;
  RCC_OscInitStruct.PLL.PLLR = 2;
  RCC_OscInitStruct.PLL.PLLRGE = RCC_PLL1VCIRANGE_2;
  RCC_OscInitStruct.PLL.PLLVCOSEL = RCC_PLL1VCOWIDE;
  RCC_OscInitStruct.PLL.PLLFRACN = 0;
  if (HAL_RCC_OscConfig(&RCC_OscInitStruct) != HAL_OK)
  {
    Error_Handler();
  }

  /** Initializes the CPU, AHB and APB buses clocks
  */
  RCC_ClkInitStruct.ClockType = RCC_CLOCKTYPE_HCLK|RCC_CLOCKTYPE_SYSCLK
                              |RCC_CLOCKTYPE_PCLK1|RCC_CLOCKTYPE_PCLK2
                              |RCC_CLOCKTYPE_D3PCLK1|RCC_CLOCKTYPE_D1PCLK1;
  RCC_ClkInitStruct.SYSCLKSource = RCC_SYSCLKSOURCE_PLLCLK;
  RCC_ClkInitStruct.SYSCLKDivider = RCC_SYSCLK_DIV1;
  RCC_ClkInitStruct.AHBCLKDivider = RCC_HCLK_DIV2;
  RCC_ClkInitStruct.APB3CLKDivider = RCC_APB3_DIV2;
  RCC_ClkInitStruct.APB1CLKDivider = RCC_APB1_DIV2;
  RCC_ClkInitStruct.APB2CLKDivider = RCC_APB2_DIV2;
  RCC_ClkInitStruct.APB4CLKDivider = RCC_APB4_DIV2;

  if (HAL_RCC_ClockConfig(&RCC_ClkInitStruct, FLASH_LATENCY_2) != HAL_OK)
  {
    Error_Handler();
  }
}

/* USER CODE BEGIN 4 */

/* USER CODE END 4 */

/**
  * @brief  This function is executed in case of error occurrence.
  * @retval None
  */
void Error_Handler(void)
{
  /* USER CODE BEGIN Error_Handler_Debug */
  /* User can add his own implementation to report the HAL error return state */
  __disable_irq();
  while (1)
  {
  }
  /* USER CODE END Error_Handler_Debug */
}

#ifdef  USE_FULL_ASSERT
/**
  * @brief  Reports the name of the source file and the source line number
  *         where the assert_param error has occurred.
  * @param  file: pointer to the source file name
  * @param  line: assert_param error line source number
  * @retval None
  */
void assert_failed(uint8_t *file, uint32_t line)
{
  /* USER CODE BEGIN 6 */
  /* User can add his own implementation to report the file name and line number,
     ex: printf("Wrong parameters value: file %s on line %d\r\n", file, line) */
  /* USER CODE END 6 */
}
#endif /* USE_FULL_ASSERT */
